## sdkconfig.defaults
```kconfig
# sdkconfig.defaults for Waveshare ESP32-S3-ETH-8DI-8RO
# Target: ESP32-S3, Ethernet: W5500 (SPI)
# After changes: idf.py fullclean && idf.py set-target esp32s3 && idf.py build

# --- Target ---
CONFIG_IDF_TARGET="esp32s3"

# --- Flash ---
CONFIG_ESPTOOLPY_FLASHSIZE_16MB=y

# --- PSRAM ---
CONFIG_SPIRAM=y
CONFIG_SPIRAM_MODE_OCT=y
CONFIG_SPIRAM_SPEED_80M=y

# --- Ethernet: W5500 SPI (Waveshare board pinout) ---
CONFIG_EXAMPLE_USE_SPI_ETHERNET=y
CONFIG_EXAMPLE_SPI_ETHERNETS_NUM=1
CONFIG_EXAMPLE_USE_W5500=y
CONFIG_EXAMPLE_ETH_SPI_HOST=1
CONFIG_EXAMPLE_ETH_SPI_SCLK_GPIO=15
CONFIG_EXAMPLE_ETH_SPI_MOSI_GPIO=13
CONFIG_EXAMPLE_ETH_SPI_MISO_GPIO=14
CONFIG_EXAMPLE_ETH_SPI_CLOCK_MHZ=16
CONFIG_EXAMPLE_ETH_SPI_CS0_GPIO=16
CONFIG_EXAMPLE_ETH_SPI_INT0_GPIO=12
CONFIG_EXAMPLE_ETH_SPI_PHY_RST0_GPIO=-1
CONFIG_EXAMPLE_ETH_SPI_PHY_ADDR0=1

# --- Partition table ---
CONFIG_PARTITION_TABLE_CUSTOM=y
CONFIG_PARTITION_TABLE_CUSTOM_FILENAME="partitions.csv"

# --- NVS ---
CONFIG_NVS_ENCRYPTION=n
```
